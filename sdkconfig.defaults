## sdkconfig.defaults
```kconfig
CONFIG_ESPTOOLPY_PORT="/dev/tty.SLAB_USBtoUART"
CONFIG_ESPTOOLPY_BAUD_OTHER=y
CONFIG_ESPTOOLPY_BAUD_OTHER_VAL=1497600
CONFIG_ESPTOOLPY_COMPRESSED=y

CONFIG_SPIRAM_SUPPORT=y
```
